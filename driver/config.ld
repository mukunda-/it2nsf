#-------------------------------------------------------------------------
# NSF Memory Specification
#-------------------------------------------------------------------------

#*************************************************************************
MEMORY {
#*************************************************************************

#-------------------------------------------------------------------------
# Program (5K)
#-------------------------------------------------------------------------
	HEADER:	start = $7F80, size = $80, fill = yes;
	VECTORS: start = $8000, size = $18, fill = yes;
	VERSION: start = $8018, size = $0C, fill = yes;
	PROG:	start = $8024, size = $14DC, fill = no;
	
#-------------------------------------------------------------------------
# Memory
#-------------------------------------------------------------------------
	
	ZMEM:	start = $0000, size = 256;		# 2k mem
	MEM:	start = $0200, size = 512;		#
}

#*************************************************************************
SEGMENTS {
#*************************************************************************

#-------------------------------------------------------------------------
# standard segments
#-------------------------------------------------------------------------
	HEADER:		load = HEADER, type = ro;					# NSF header
	VECTORS:	load = VECTORS, type = ro, define = yes;	# PROGRAM VECTORS
	VERSION:	load = VERSION, type = ro, define = yes;	# VERSION STRING
	CODE:		load = PROG, type = ro, define = yes;		# 5k code
	ZEROPAGE:	load = ZMEM, type = zp;						# zero page
	BSS:		load = MEM, type = bss;						# 2k (minus zpage) bss
}
